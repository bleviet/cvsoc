## 10_linux_led/br2-external/Config.in
```kconfig
source "$BR2_EXTERNAL_DE10_NANO_PATH/package/fpga-led/Config.in"
source "$BR2_EXTERNAL_DE10_NANO_PATH/package/fpga-mgr-load/Config.in"
```

## 10_linux_led/br2-external/package/fpga-led/Config.in
```kconfig
config BR2_PACKAGE_FPGA_LED
	bool "fpga-led"
	help
	  User-space application that controls FPGA LEDs on the DE10-Nano
	  board via the UIO (Userspace I/O) driver.

	  The application maps the LED PIO peripheral registers through
	  /dev/uioX and cycles through LED patterns.

	  https://github.com/bleviet/cvsoc
```

## 10_linux_led/br2-external/package/fpga-mgr-load/Config.in
```kconfig
config BR2_PACKAGE_FPGA_MGR_LOAD
	bool "fpga-mgr-load"
	depends on BR2_LINUX_KERNEL
	help
	  Kernel module that programs the Cyclone V FPGA using the kernel's
	  FPGA Manager API (fpga_mgr_load). Used at boot via S30fpga_load
	  init script to place the FPGA into USER_MODE before the LED UIO
	  device becomes accessible.
```

## 11_ethernet_hps_led/br2-external/configs/de10_nano_defconfig
```kconfig
# Buildroot defconfig for DE10-Nano Cyclone V SoC (cvsoc tutorial Phase 7)
#
# Build with:
#   make BR2_EXTERNAL=<path>/br2-external de10_nano_defconfig
#   make
#
# Produces: output/images/sdcard.img
#
# Prerequisites: Phase 6 must have been built first so that de10_nano.rbf
# and the fpga_led / fpga_load software sources are available.

# ── Architecture: ARM Cortex-A9 (Cyclone V HPS) ─────────────────────────────
BR2_arm=y
BR2_cortex_a9=y
BR2_ARM_ENABLE_NEON=y
BR2_ARM_ENABLE_VFP=y
BR2_ARM_FPU_NEON_VFPV3=y

# ── Toolchain ────────────────────────────────────────────────────────────────
BR2_TOOLCHAIN_BUILDROOT_GLIBC=y

# ── Kernel headers ───────────────────────────────────────────────────────────
BR2_KERNEL_HEADERS_6_6=y

# ── Linux kernel ─────────────────────────────────────────────────────────────
BR2_LINUX_KERNEL=y
BR2_LINUX_KERNEL_CUSTOM_VERSION=y
BR2_LINUX_KERNEL_CUSTOM_VERSION_VALUE="6.6.86"
BR2_LINUX_KERNEL_DEFCONFIG="socfpga"
BR2_LINUX_KERNEL_CONFIG_FRAGMENT_FILES="$(BR2_EXTERNAL_DE10_NANO_PATH)/board/de10_nano/linux-uio.fragment"
BR2_LINUX_KERNEL_DTS_SUPPORT=y
BR2_LINUX_KERNEL_INTREE_DTS_NAME="intel/socfpga/socfpga_cyclone5_de0_nano_soc"
BR2_LINUX_KERNEL_NEEDS_HOST_OPENSSL=y

# ── U-Boot (bootloader) ─────────────────────────────────────────────────────
BR2_TARGET_UBOOT=y
BR2_TARGET_UBOOT_BUILD_SYSTEM_KCONFIG=y
BR2_TARGET_UBOOT_CUSTOM_VERSION=y
BR2_TARGET_UBOOT_CUSTOM_VERSION_VALUE="2024.07"
BR2_TARGET_UBOOT_BOARD_DEFCONFIG="socfpga_de10_nano"
BR2_TARGET_UBOOT_CONFIG_FRAGMENT_FILES="$(BR2_EXTERNAL_DE10_NANO_PATH)/board/de10_nano/uboot.fragment"
BR2_TARGET_UBOOT_FORMAT_IMG=y
BR2_TARGET_UBOOT_SPL=y
BR2_TARGET_UBOOT_SPL_NAME="u-boot-with-spl.sfp"

# ── Root filesystem ──────────────────────────────────────────────────────────
BR2_TARGET_ROOTFS_EXT2=y
BR2_TARGET_ROOTFS_EXT2_4=y
BR2_TARGET_ROOTFS_EXT2_SIZE="128M"

# ── SD card image generation ─────────────────────────────────────────────────
BR2_ROOTFS_POST_BUILD_SCRIPT="$(BR2_EXTERNAL_DE10_NANO_PATH)/board/de10_nano/post-build.sh"
BR2_ROOTFS_POST_IMAGE_SCRIPT="$(BR2_EXTERNAL_DE10_NANO_PATH)/board/de10_nano/post-image.sh support/scripts/genimage.sh"
BR2_ROOTFS_POST_SCRIPT_ARGS="-c $(BR2_EXTERNAL_DE10_NANO_PATH)/board/de10_nano/genimage.cfg"

# ── Host tools ───────────────────────────────────────────────────────────────
BR2_PACKAGE_HOST_GENIMAGE=y
BR2_PACKAGE_HOST_DTC=y

# ── Target packages ──────────────────────────────────────────────────────────
# FPGA LED user-space application (reused from Phase 6)
BR2_PACKAGE_FPGA_LED=y

# Kernel module to program FPGA at boot (reused from Phase 6)
BR2_PACKAGE_FPGA_MGR_LOAD=y

# UDP server for remote LED control (Phase 7 new)
BR2_PACKAGE_LED_SERVER=y

# Python 3 for scripting
BR2_PACKAGE_PYTHON3=y

# ── System configuration ─────────────────────────────────────────────────────
BR2_TARGET_GENERIC_HOSTNAME="de10nano"
BR2_TARGET_GENERIC_ISSUE="Welcome to DE10-Nano (cvsoc Phase 7 — Ethernet LED control)"
BR2_TARGET_GENERIC_ROOT_PASSWD=""
BR2_SYSTEM_DHCP="eth0"
BR2_INIT_BUSYBOX=y
```

## 11_ethernet_hps_led/br2-external/package/led-server/Config.in
```kconfig
config BR2_PACKAGE_LED_SERVER
	bool "led-server"
	help
	  UDP server that receives LED pattern commands from a PC and writes
	  them to the FPGA LED PIO register on the DE10-Nano.

	  Phase 7 Track A — HPS Ethernet LED control.

	  Protocol (2-byte request / 2-byte response):
	    CMD 0x01 = SET_PATTERN
	    CMD 0x02 = GET_PATTERN

	  https://github.com/bleviet/cvsoc
```

## 16_field_update/br2-external/package/fpga-mgr-load/Config.in
```kconfig
config BR2_PACKAGE_FPGA_MGR_LOAD
	bool "fpga-mgr-load"
	help
	  Kernel module that programs the Cyclone V FPGA from
	  /lib/firmware/de10_nano.rbf using the kernel FPGA Manager API.

	  Reused unchanged from Phase 6 (10_linux_led).

	  https://github.com/bleviet/cvsoc
```

## 17_opcua_hps_led/br2-external/package/fpga-led/Config.in
```kconfig
config BR2_PACKAGE_FPGA_LED
	bool "fpga-led"
	help
	  User-space application that controls FPGA LEDs on the DE10-Nano
	  board via /dev/mem mmap of the LW H2F bridge.

	  Reused unchanged from Phase 6 (10_linux_led).

	  https://github.com/bleviet/cvsoc
```
