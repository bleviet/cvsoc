## 13_secure_boot/fit_image.its
```
/*
 * fit_image.its
 *
 * U-Boot Flattened Image Tree (FIT) Source for the DE10-Nano.
 *
 * This file describes how to pack the Linux Kernel, Device Tree, and
 * FPGA Bitstream into a single ITB (Image Tree Blob) and digitally
 * sign it using an RSA key pair.
 */

/dts-v1/;

/ {
    description = "Signed Firmware Image for DE10-Nano (Linux + DTB + FPGA)";
    #address-cells = <1>;

    images {
        kernel {
            description = "Linux Kernel";
            data = /incbin/("../10_linux_led/buildroot-2024.11.1/output/images/zImage");
            type = "kernel";
            arch = "arm";
            os = "linux";
            compression = "none";
            load = <0x80008000>;
            entry = <0x80008000>;
            hash-1 {
                algo = "sha256";
            };
        };

        fdt {
            description = "DE10-Nano Device Tree";
            data = /incbin/("../10_linux_led/buildroot-2024.11.1/output/images/socfpga_cyclone5_de0_nano_soc.dtb");
            type = "flat_dt";
            arch = "arm";
            compression = "none";
            load = <0x80000100>;
            hash-1 {
                algo = "sha256";
            };
        };

        fpga {
            description = "FPGA Bitstream (Raw Binary File)";
            data = /incbin/("../10_linux_led/buildroot-2024.11.1/output/images/de10_nano.rbf");
            type = "fpga";
            arch = "arm";
            compression = "none";
            load = <0x02000000>;
            hash-1 {
                algo = "sha256";
            };
        };
    };

    configurations {
        default = "conf-1";

        conf-1 {
            description = "Boot Linux with FPGA";
            kernel = "kernel";
            fdt = "fdt";
            fpga = "fpga";
            signature {
                algo = "sha256,rsa2048";
                key-name-hint = "dev_key";
                sign-images = "kernel", "fdt", "fpga";
            };
        };
    };
};
```

## 17_opcua_hps_led/br2-external/package/led-opcua-server/Config.in
```kconfig
config BR2_PACKAGE_LED_OPCUA_SERVER
	bool "led-opcua-server"
	help
	  Industrial OPC UA Binary Server (opc.tcp port 4840) and Part 14 UADP
	  PubSub publisher (UDP port 4841) that exposes the DE10-Nano FPGA LED
	  PIO peripheral as a browsable, self-describing OPC UA Address Space.

	  Phase 11 (17_opcua_hps_led) — Industrial IIoT with OPC UA.
```
